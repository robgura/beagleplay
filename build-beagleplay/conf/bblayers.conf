## build-beagleplay/conf/bblayers.conf
```bitbake
# POKY_BBLAYERS_CONF_VERSION is increased each time build/conf/bblayers.conf
# changes incompatibly
POKY_BBLAYERS_CONF_VERSION = "2"

BBPATH = "${TOPDIR}"
BBFILES ?= ""

BBLAYERS ?= " \
  ${TOPDIR}/../yocto/meta/poky/meta \
  ${TOPDIR}/../yocto/meta/poky/meta-poky \
  ${TOPDIR}/../yocto/meta/meta-openembedded/meta-oe \
  ${TOPDIR}/../yocto/meta/meta-openembedded/meta-python \
  ${TOPDIR}/../yocto/meta/meta-openembedded/meta-networking \
  ${TOPDIR}/../yocto/meta/meta-openembedded/meta-multimedia \
  ${TOPDIR}/../yocto/meta/meta-openembedded/meta-webserver \
  ${TOPDIR}/../yocto/meta/meta-openembedded/meta-gnome \
  ${TOPDIR}/../yocto/meta/meta-arm/meta-arm \
  ${TOPDIR}/../yocto/meta/meta-arm/meta-arm-toolchain \
  ${TOPDIR}/../yocto/meta/meta-ti/meta-ti-bsp \
  ${TOPDIR}/../meta-display \
  "
```
