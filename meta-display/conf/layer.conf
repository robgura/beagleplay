## meta-display/conf/layer.conf
```bitbake
# We have a conf and classes directory, add to BBPATH
BBPATH .= ":${LAYERDIR}"

# We have recipes-* directories, add to BBFILES
BBFILES += "${LAYERDIR}/recipes-*/*/*.bb \
            ${LAYERDIR}/recipes-*/*/*.bbappend"

BBFILE_COLLECTIONS += "display"
BBFILE_PATTERN_display = "^${LAYERDIR}/"
BBFILE_PRIORITY_display = "6"

LAYERDEPENDS_display = "core"
LAYERSERIES_COMPAT_display = "kirkstone"
```
